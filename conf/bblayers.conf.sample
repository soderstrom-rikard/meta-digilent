## conf/bblayers.conf.sample
```bitbake
# LAYER_CONF_VERSION is increased each time build/conf/bblayers.conf
# changes incompatibly
LCONF_VERSION = "6"

BBPATH = "${TOPDIR}"
BBFILES ?= ""

BBLAYERS ?= " \
  /tool/yocto/poky/meta \
  /tool/yocto/poky/meta-yocto \
  /tool/yocto/poky/meta-yocto-bsp \
  /tool/yocto/meta-xilinx \
  /tool/yocto/meta-xilinx-community \
  "
BBLAYERS_NON_REMOVABLE ?= " \
  /tool/yocto/poky/meta \
  /tool/yocto/poky/meta-yocto \
  "
```

## conf/layer.conf
```bitbake
# We have a conf and classes directory, add to BBPATH
BBPATH .= ":${LAYERDIR}"

# We have a  recipes-* directory, add to BBFILES
BBFILES += "${LAYERDIR}/recipes-*/*/*.bb \
            ${LAYERDIR}/recipes-*/*/*.bbappend"

BBFILE_COLLECTIONS += "xilinx"
BBFILE_PATTERN_xilinx = "^${LAYERDIR}/"
BBFILE_PRIORITY_xilinx = "6"
```

## conf/machine/include/tune-microblaze.inc
```bitbake
DEFAULTTUNE ?= "microblaze"

TUNEVALID[microblaze] = "Enable microblaze specific processor optimizations"
TUNE_CCARGS += "${@bb.utils.contains("TUNE_FEATURES", "microblaze", "-mcpu=v8.10a", "", d)}"
TUNE_PKGARCH = "${@bb.utils.contains("TUNE_FEATURES", "microblaze", "microblaze", "${PPCPKGARCH}", d)}"

TARGET_FPU = "soft"
AVAILTUNES += "microblaze"
TUNE_FEATURES_tune-microblaze = "m32 microblaze"
PACKAGE_EXTRA_ARCHS_tune-microblaze = "microblaze"

#MACHINEOVERRIDES .= "microblaze"
```

## conf/machine/include/tune-microblazeel.inc
```bitbake
TARGET_FPU ?= "soft"
TARGET_CC_ARCH = "-mcpu=v8.10.a"
BASE_PACKAGE_ARCH = "microblazeel"
FEED_ARCH = "microblaze"
```

## conf/machine/include/tune-ppc405.inc
```bitbake
DEFAULTTUNE ?= "ppc405"

require conf/machine/include/powerpc/arch-powerpc.inc

TUNEVALID[ppc405] = "Enable ppc405 specific processor optimizations"
TUNE_CCARGS += "${@bb.utils.contains("TUNE_FEATURES", "ppc405", "-mcpu=405", "", d)}"

AVAILTUNES += "ppc405"
TUNE_FEATURES_tune-ppc405 = "m32 ppc405 fpu-soft"
TUNE_PKGARCH_tune-ppc405 = "ppc405"
PACKAGE_EXTRA_ARCHS_tune-ppc405 = "${PACKAGE_EXTRA_ARCHS_tune-powerpc-nf} ppc405"

# glibc configure options to get ppc405 specific library (for sqrt)
GLIBC_EXTRA_OECONF += "${@bb.utils.contains("TUNE_FEATURES", "ppc405", "-with-cpu=405", "", d)}"
```

## conf/machine/include/tune-ppc405e.inc
```bitbake
DEFAULTTUNE ?= "ppc405e"

require conf/machine/include/powerpc/arch-powerpc.inc

TUNEVALID[ppc405e] = "Enable ppc405e specific processor optimizations"
TUNE_CCARGS += "${@bb.utils.contains("TUNE_FEATURES", "ppc405e", "-mcpu=405fp", "", d)}"

AVAILTUNES += "ppc405e"
TUNE_FEATURES_tune-ppc405e = "m32 ppc405e fpu-hard"
TUNE_PKGARCH_tune-ppc405e = "ppc405e"
PACKAGE_EXTRA_ARCHS_tune-ppc405e = "${PACKAGE_EXTRA_ARCHS_tune-powerpc} ppc405e"

# glibc configure options to get ppc405e specific library (for sqrt)
GLIBC_EXTRA_OECONF += "${@bb.utils.contains("TUNE_FEATURES", "ppc405e", "-with-cpu=405fp", "", d)}"
```

## conf/machine/include/tune-ppc440.inc
```bitbake
DEFAULTTUNE ?= "ppc440"

require conf/machine/include/powerpc/arch-powerpc.inc

TUNEVALID[ppc440] = "Enable ppc440 specific processor optimizations"
TUNE_CCARGS += "${@bb.utils.contains("TUNE_FEATURES", "ppc440", "-mcpu=440", "", d)}"

AVAILTUNES += "ppc440"
TUNE_FEATURES_tune-ppc440 = "m32 fpu-soft ppc440"
TUNE_PKGARCH_tune-ppc440 = "ppc440"
PACKAGE_EXTRA_ARCHS_tune-ppc440 = "${PACKAGE_EXTRA_ARCHS_tune-powerpc-nf} ppc440"

# glibc configure options to get ppc440 specific library (for sqrt)
GLIBC_EXTRA_OECONF += "${@bb.utils.contains("TUNE_FEATURES", "ppc440", "-with-cpu=440", "", d)}"
```

## conf/machine/include/tune-ppc440e.inc
```bitbake
DEFAULTTUNE ?= "ppc440e"

require conf/machine/include/powerpc/arch-powerpc.inc

TUNEVALID[ppc440e] = "Enable ppc440e specific processor optimizations"
TUNE_CCARGS += "${@bb.utils.contains("TUNE_FEATURES", "ppc440e", "-mcpu=440fp", "", d)}"

AVAILTUNES += "ppc440e"
TUNE_FEATURES_tune-ppc440e = "m32 ppc440e fpu-hard"
TUNE_PKGARCH_tune-ppc440e = "ppc440e"
PACKAGE_EXTRA_ARCHS_tune-ppc440e = "${PACKAGE_EXTRA_ARCHS_tune-powerpc} ppc440e"

# glibc configure options to get ppc440e specific library (for sqrt)
GLIBC_EXTRA_OECONF += "${@bb.utils.contains("TUNE_FEATURES", "ppc440e", "-with-cpu=440fp", "", d)}"
```

## conf/machine/include/virtex-4/virtex-4-base.inc
```bitbake
# Provides the Xilinx Virtex-4 common settings

# Specify the SOC Family
SOC_FAMILY = "virtex-4"

include conf/machine/include/virtex-4-default-providers.inc

# Add u-boot image to rootfs
EXTRA_IMAGEDEPENDS = "u-boot-xilinx"

# Specify kernel image type
KERNEL_IMAGETYPE = "uImage"

# Ship kernel modules
MACHINE_EXTRA_RRECOMMENDS = "kernel-modules"

# Specify rootfs image filesystem types
IMAGE_FSTYPES += "tar.gz"
```

## conf/machine/include/virtex-4/virtex-4-default-providers.inc
```bitbake
# Xilinx Virtex-4 BSP default providers

#ASSUME_PROVIDED += "virtual/kernel"
PREFERRED_PROVIDER_virtual/kernel ?= "linux-xilinx"
PREFERRED_PROVIDER_u-boot ?= "u-boot-xilinx"
```

## conf/machine/include/virtex-5/virtex-5-base.inc
```bitbake
# Provides the Xilinx Virtex-5 common settings

# Specify the SOC Family
SOC_FAMILY = "virtex-5"

include conf/machine/include/virtex-5-default-providers.inc

# Add u-boot image to rootfs
EXTRA_IMAGEDEPENDS = "u-boot-xilinx"

# Specify kernel image type
KERNEL_IMAGETYPE = "uImage"

# Ship kernel modules
MACHINE_EXTRA_RRECOMMENDS = "kernel-modules"

# Specify rootfs image filesystem types
IMAGE_FSTYPES += "tar.gz"
```

## conf/machine/include/virtex5/virtex5-default-versions.inc
```bitbake
# Xilinx Virtex-5 BSP default versions

PREFERRED_VERSION_virtual/kernel ?= "3.3"
PREFERRED_VERSION_linux-libc-headers = "3.3"
PREFERRED_VERSION_u-boot = "git"
```

## conf/machine/include/zynq-7/zynq-7-base.inc
```bitbake
# Provides the Xilinx Zynq-7 common settings

include conf/machine/include/zynq-7-default-providers.inc
include conf/machine/include/zynq-7-default-versions.inc
```

## conf/machine/include/zynq-7/zynq-7-default-providers.inc
```bitbake
# Xilinx Zynq-7 BSP default providers

PREFERRED_PROVIDER_virtual/kernel ?= "linux-xilinx"
PREFERRED_PROVIDER_u-boot ?= "u-boot-xilinx"
```

## conf/machine/include/zynq-7/zynq-7-default-versions.inc
```bitbake
# Xilinx Zynq-7 BSP default versions

PREFERRED_VERSION_virtual/kernel ?= "3.6"
PREFERRED_VERSION_linux-libc-headers = "3.6"
PREFERRED_VERSION_u-boot = "2012.10"
```

## conf/machine/include/zynq-zx3.inc
```bitbake
#@TYPE: Machine
#@NAME: zynq-zy3
#@DESCRIPTION: Machine configuration for the zx3 module
#@HOMEPAGE = "http://www.netmodule.com"

require conf/machine/include/tune-zynq.inc
require conf/machine/include/machine-xilinx-default.inc

MACHINE_FEATURES := ""
#IMAGE_FSTYPES and IMAGE_ROOTFS_SIZE are set in recipes-core/images/
#
#when we set limits, we really mean it
IMAGE_OVERHEAD_FACTOR := "1"
#QSPI flash has 64kB erase size
EXTRA_IMAGECMD_jffs2 = "-lnp -e64KiB"

SERIAL_CONSOLE = "115200 ttyPS0"

# microZed machine definition known by Xilinx UBOOT
UBOOT_MACHINE = "zx3_ze7000"

# force the kernel creation process to create a new uImage with the correct addresses
KEEPUIMAGE = "no"

#generate ramdisk, rootfs and ubi
IMAGE_ROOTFS_SIZE = "32768"
IMAGE_FSTYPES := "ext2.gz tar.bz2 ubi ubifs"

#1023 erase blocks with a size of 126KiB =  something around 125.877 MB
MKUBIFS_ARGS = "-m 2048 -e 126976 -c 4096"
UBINIZE_ARGS = "-m 2048 -p 128KiB"

UBI_VOLNAME = "ubi-rootfs"

UBOOT_LOADADDRESS = "0x00008000"
UBOOT_ENTRYPOINT = "${UBOOT_LOADADDRESS}"
# force the kernel creation process to create a new uImage with the correct addresses
KEEPUIMAGE = "no"
```

## conf/machine/microzed-zynq7.conf
```bitbake
# Copyright (C) 2014, David Andrey <david.andrey@netmodule.com>
#@TYPE: Machine
#@NAME: microzed-zynq7
#@DESCRIPTION: Machine support for microZed. (http://www.microzed.org/)

# Versions corresponding to microzed documentation
PREFERRED_VERSION_linux-xlnx ?= "3.14%"
PREFERRED_VERSION_u-boot-xlnx ?= "v2013.01%"

require conf/machine/include/tune-zynq.inc
require conf/machine/include/machine-xilinx-default.inc

# microZed machine definition known by Xilinx UBOOT
UBOOT_MACHINE = "zynq_zed_config"

SERIAL_CONSOLE = "115200 ttyPS0"

MACHINE_DEVICETREE := " \
		microzed/microzed-zynq7.dtsi \
		microzed/microzed-zynq7-ram.dts \
		"

MACHINE_KCONFIG := " \
		microzed/microzed-blk-dev-ram.cfg \
		"
```

## conf/machine/spartan6-lx9mb.conf
```bitbake
# Copyright (C) 2011, SecretLab Technologies Ltd.
# Adrian Alonso <aalonso@secretlab.ca>
# Released under the MIT license (see packages/COPYING)
#@TYPE: Machine
#@Name: Xilinx generic microblaze target support
#@DESCRIPTION: Machine configuration for Xilinx Microblaze
# Supported target: spartan6-lx9mb
#
# Xilinx EDK override hardware  definitions for xilinx-bsp
# Include in your local.conf
# XILINX_BSP_PATH = "complete path for Xilinx XPS project"

TARGET_ARCH = "microblaze"
TARGET_CPU = "microblaze"
TARGET_FPU = "soft"
# tune for the microblaze cpu
require conf/machine/include/tune-microblaze.inc

PREFERRED_PROVIDER_virtual/kernel = "linux-xilinx"
PREFERRED_VERSION_u-boot_microblaze = "uboot-xilinx"
# Add uboot to rootfs
EXTRA_IMAGEDEPENDS += "u-boot-xilinx"

KERNEL_IMAGETYPE = "simpleImage.system"

MACHINE_FEATURES = "kernel26 apm ext2 vfat ethernet"
MACHINE_EXTRA_RECOMMENDS = "kernel-modules"

UBOOT_ENTRYPOINT ?= "0x00000000"
UBOOT_LOADADDRESS ?= "0x00000000"
UBOOT_MACHINE ?= "microblaze-generic_config"

# Don't use tty1
USE_VT = "0"
SERIAL_CONSOLE = "115200 ttyUL0"

# Device nodes add xsa for (system ace)
IMAGE_DEVICE_TABLES = "files/device_table-minimal.txt \
                       files/device_table_add-xsa.txt"
```

## conf/machine/virtex-4-ml405-powerpc-405.conf
```bitbake
# Copyright (C) 2010, Adrian Alonso <aalonso00@gmail.com>
# Copyright (C) 2013, Elvis Dowson <elvis.dowson@gmail.com>
# Released under the MIT license (see packages/COPYING)
#@TYPE: Machine
#@Name: virtex-4-ml405-powerpc-405
#@DESCRIPTION: Machine configuration for the Xilinx ML405 FPGA development platform with a Virtex-4 PowerPC 405 processor (with APU FPU).
# Compatible targets include ML401, ML403, ML405, ML410.

# Specify target cpu
TARGET_CPU  = "405"

# Include Virtex-4 base definitions
include conf/machine/include/virtex-4/virtex-4-base.inc

# Specify tune file for PowerPC405 processor with APU FPU hardware floating point support
require conf/machine/include/tune-ppc405e.inc

# Specify linux kernel devicetree
KERNEL_DEVICETREE = "${S}/arch/powerpc/boot/dts/virtex405-ml405.dts"

# Specify u-boot machine configuration
UBOOT_MACHINE ?= "ppc405-generic_config"
UBOOT_ENTRYPOINT ?= "0x00000000"
UBOOT_LOADADDRESS ?= "0x00000000"

# Specify the Xilinx board name
XILINX_BOARD = "ml405"

# Xilinx EDK override hardware  definitions for xilinx-bsp
# Include the following environment variables in your local.conf
# XILINX_BSP_PATH = "complete path to the Xilinx XPS project"

# Specify serial console settings
# Don't use tty1
# USE_VT = "0"
SERIAL_CONSOLE ?= "115200 ttyUL0"

# Device nodes add xsa for (system ace)
IMAGE_DEVICE_TABLES = "files/device_table_add-xsa.txt"
```

## conf/machine/virtex-5-ml507-powerpc-440.conf
```bitbake
# Copyright (C) 2012, Elvis Dowson <elvis.dowson@gmail.com>
# Released under the MIT license (see packages/COPYING)
#@TYPE: Machine
#@Name: virtex-5-ml507-powerpc-440
#@DESCRIPTION: Machine configuration for the Xilinx ML507 FPGA development platform with a Virtex-5 PowerPC 440 processor (with APU FPU).

include conf/machine/include/virtex-5/virtex-5-base.inc
include conf/machine/include/tune-ppc440e.inc

# Specify linux kernel devicetree
KERNEL_DEVICETREE = "${S}/arch/powerpc/boot/dts/virtex440-ml507.dts"

# Specify u-boot machine configuration
UBOOT_MACHINE ?= "ml507_config"
UBOOT_ENTRYPOINT ?= "0x00000000"
UBOOT_LOADADDRESS ?= "0x00000000"

# Specify machine features
MACHINE_FEATURES = "kernel26 apm ext2 ext3 vfat ethernet keyboard screen serial"
MACHINE_FEATURES_BACKFILL_CONSIDERED = "rtc"

# Specify the Xilinx board name
XILINX_BOARD = "ml507"

# Xilinx EDK override hardware  definitions for xilinx-bsp
# Include the following environment variables in your local.conf
# XILINX_BSP_PATH = "complete path to the Xilinx XPS project"

# Specify serial console settings
# Don't use tty1
# USE_VT = "0"
SERIAL_CONSOLE ?= "115200 ttyUL0"

# Device nodes add xsa for (system ace)
IMAGE_DEVICE_TABLES = "files/device_table_add-xsa.txt"
```

## conf/machine/zc702-base-trd-zynq7.conf
```bitbake
#@TYPE: Machine
#@NAME: zc702-base-trd-zynq7
#@DESCRIPTION: Machine support for ZC702 Base TRD.
#
# For details on the Evaluation board:
#     http://www.xilinx.com/products/boards-and-kits/EK-Z7-ZC702-G.htm
# For documentation and design files for the ZC702 Base TRD:
#     http://www.wiki.xilinx.com/Zc702+Base+TRD

PREFERRED_VERSION_linux-xlnx ?= "3.10%"

# include the zc702, as this design builds upon it.
include conf/machine/zc702-zynq7.conf

MACHINE_DEVICETREE_append += " \
		common/zynq7-base-trd.dtsi \
		zc702/zc702-base-trd-zynq7.dts \
		"
```

## conf/machine/zc706-pcie-trd-zynq7.conf
```bitbake
#@TYPE: Machine
#@NAME: zc706-pcie-trd-zynq7
#@DESCRIPTION: Machine support for ZC706 PCIe TRD.
#
# For details on the Evaluation board:
#     http://www.xilinx.com/products/boards-and-kits/EK-Z7-ZC706-G.htm
# For documentation and design files for the ZC702 Base TRD:
#     http://www.wiki.xilinx.com/ZYNQ_PCIe_TRD_14.7

PREFERRED_VERSION_linux-xlnx ?= "3.10%"

# include the zc706, as this design builds upon it.
include conf/machine/zc706-zynq7.conf

MACHINE_DEVICETREE_append += " \
		zc706/zc706-pcie-trd-zynq7-qspi.dts \
		"
```

## conf/machine/ze7000-zynq7.conf
```bitbake
#@TYPE: Machine
#@NAME: ze7000-zynq7
#@DESCRIPTION: Machine configuraiton for the ze7000 from NetModule device
#@HOMEPAGE = "http://www.netmodule.com"

require conf/machine/include/zynq-zx3.inc

MACHINE_DEVICETREE := " \
		ze7000/ze7000-zynq7.dts \
		"

PREFERRED_PROVIDER_virtual/kernel ?= "linux-xlnx"
PREFERRED_VERSION_linux-xlnx ?= "3.14%"

MACHINE_ESSENTIAL_EXTRA_RRECOMMENDS += "kernel-module-xilinx-emacps"
```

## conf/machine/zx3-pm3-zynq7.conf
```bitbake
#@TYPE: Machine
#@NAME: zx3-pm3-zynq7
#@DESCRIPTION: Machine configuration for Enclustra PM3 evaluation board with ZX3 module
#@HOMEPAGE = "http://www.enclustra.ch"

require conf/machine/include/zynq-zx3.inc

MACHINE_DEVICETREE := " \
        zx3-pm3/zx3-pm3-zynq7.dts \
        "

PREFERRED_PROVIDER_virtual/kernel ?= "linux-xlnx"
PREFERRED_VERSION_linux-xlnx ?= "3.14%"

MACHINE_ESSENTIAL_EXTRA_RRECOMMENDS += "kernel-module-xilinx-emacps"

PREFERRED_VERSION_u-boot-zx3 = "2013.04-git%"
```

## conf/machine/zybo-zynq7.conf
```bitbake
# Copyright (C) 2014, Rikard Söderström <soderstrom.rikard@gmail.com>
#@TYPE: Machine
#@NAME: zybo-zynq7
#@DESCRIPTION: Machine support for Zybo. (http://www.digilentinc.com/)

# Versions corresponding to microzed documentation
PREFERRED_PROVIDER_virtual/kernel_zybo-zynq7 ?= "linux-digilent"
PREFERRED_VERSION_linux-xlnx ?= "3.14+"
PREFERRED_VERSION_u-boot-xlnx ?= "${UBOOT_XLNX_DEV_BRANCH}"

require conf/machine/include/tune-zynq.inc
require conf/machine/include/machine-xilinx-default.inc

# ZYBO machine definition known by Xilinx UBOOT
UBOOT_MACHINE = "zynq_zybo_config"
UBOOT_LOADADDRESS = "0x00000000"
UBOOT_ENTRYPOINT = "${UBOOT_LOADADDRESS}"

SERIAL_CONSOLE = "115200 ttyPS0"

# MACHINE_DEVICETREE = "${S}/arch/arm/boot/dts/zynq-zybo.dts"
# MACHINE_DEVICETREE_append_zynq += " \
# 		common/zynq7-base.dtsi \
# KERNEL_DEVICETREE = "${S}/arch/arm/boot/dts/zynq-zybo.dts"
MY_DTS = "${S}/arch/arm/boot/dts/zynq-zybo.dts"
```
