## conf/machine/zynq-7-zc706.conf
```bitbake
# Copyright (C) 2013, Elvis Dowson <elvis.dowson@gmail.com>
# Released under the MIT license (see packages/COPYING)
#@TYPE: Machine
#@Name: Xilinx Zynq-7 ZC706 FPGA Development Platform for the Zynq-7045 processor.
#@DESCRIPTION: Machine configuration for the Xilinx Zynq-7 ZC706 FPGA Development Platform.

include conf/machine/include/zynq-7-base.inc
include conf/machine/include/tune-cortexa9.inc

require conf/machine/include/soc-family.inc

# Specify the SOC Family
SOC_FAMILY = "zynq-7"

# Specify linux kernel devicetree
KERNEL_DEVICETREE = "${S}/arch/arm/boot/dts/zynq-zc706.dts"

# Specify u-boot machine configuration
UBOOT_MACHINE = "zynq_zc70x_config"

# Specify kernel image type
KERNEL_IMAGETYPE = "uImage"

# Add u-boot image to rootfs
EXTRA_IMAGEDEPENDS = "u-boot-xilinx"

# Specify rootfs image filesystem types
IMAGE_FSTYPES += "tar.gz"

# Ship kernel modules
MACHINE_EXTRA_RRECOMMENDS = "kernel-modules"

# Specify machine features
MACHINE_FEATURES = "apm ethernet pci screen serial"

# Specify the Xilinx board name
XILINX_BOARD = "zc706"

# Xilinx EDK override hardware  definitions for xilinx-bsp
# Include the following environment variables in your local.conf
# XILINX_BSP_PATH = "complete path to the Xilinx XPS project"

# Specify serial console settings
SERIAL_CONSOLE = "115200 ttyPS0"
```

## conf/machine/zynq-7-zedboard.conf
```bitbake
# Copyright (C) 2013, Elvis Dowson <elvis.dowson@gmail.com>
# Released under the MIT license (see packages/COPYING)
#@TYPE: Machine
#@Name: Avnet Zynq Evaluation and Development Board (ZedBoard) for the Zynq-7020 processor.
#@DESCRIPTION: Machine configuration for the Avnet Zynq Evaluation and Development Board (ZedBoard).

include conf/machine/include/zynq-7-base.inc
include conf/machine/include/tune-cortexa9.inc

require conf/machine/include/soc-family.inc

# Specify the SOC Family
SOC_FAMILY = "zynq-7"

# Specify linux kernel devicetree
KERNEL_DEVICETREE = "${S}/arch/arm/boot/dts/zynq-zed.dts"

# Specify u-boot machine configuration
UBOOT_MACHINE = "zynq_zed_config"

# Specify kernel image type
KERNEL_IMAGETYPE = "uImage"

# Add u-boot image to rootfs
EXTRA_IMAGEDEPENDS = "u-boot-xilinx"

# Specify rootfs image filesystem types
IMAGE_FSTYPES += "tar.gz"

# Ship kernel modules
MACHINE_EXTRA_RRECOMMENDS = "kernel-modules"

# Specify machine features
MACHINE_FEATURES = "apm ethernet screen serial"

# Specify the Xilinx board name
XILINX_BOARD = "zedboard"

# Xilinx EDK override hardware  definitions for xilinx-bsp
# Include the following environment variables in your local.conf
# XILINX_BSP_PATH = "complete path to the Xilinx XPS project"

# Specify serial console settings
SERIAL_CONSOLE = "115200 ttyPS0"
```

## conf/machine/zynq-ze7000.conf
```bitbake
#@TYPE: Machine
#@NAME: zynq-ze7000
#@DESCRIPTION: Machine configuraiton for the ze7000 from NetModule device
#@HOMEPAGE = "http://www.netmodule.com"

require conf/machine/include/zynq-zx3.inc

MACHINE_DEVICETREE := " \
		zynq-ze7000.dtsi \
		zynq-ze7000-nand.dts \
		"
```
